## machine/aarch64/rock-5b/buildroot-external/board/boot.its
```
// SPDX-License-Identifier: (GPL-2.0 OR MIT)
// Copyright (c) 2026 Process Mission

/dts-v1/;

/ {
	description = "ROCK 5B Linux and initramfs";
	#address-cells = <1>;
	images {
		kernel {
			description = "Linux ARM64";
			data = /incbin/("Image.lzma");
			type = "kernel";
			arch = "arm64";
			os = "linux";
			compression = "lzma";
			load = <0x02000000>;
			entry = <0x02000000>;
			hash { algo = "sha256"; };
		};
		ramdisk {
			description = "Buildroot initramfs";
			data = /incbin/("rootfs.cpio.gz");
			type = "ramdisk";
			arch = "arm64";
			os = "linux";
			compression = "none";
			load = <0x12180000>;
			hash { algo = "sha256"; };
		};
		fdt {
			description = "Radxa ROCK 5B";
			data = /incbin/("rk3588-rock-5b.dtb");
			type = "flat_dt";
			arch = "arm64";
			compression = "none";
			load = <0x12000000>;
			hash { algo = "sha256"; };
		};
	};
	configurations {
		default = "conf";
		conf {
			kernel = "kernel";
			ramdisk = "ramdisk";
			fdt = "fdt";
		};
	};
};
```

## machine/riscv64/k230/buildroot-external/board/boot.its
```
// SPDX-FileCopyrightText: Copyright (c) 2026 Process Mission
// SPDX-License-Identifier: MIT

/dts-v1/;

/ {
    description = "K230 OpenSBI and Linux";
    #address-cells = <1>;

    images {
        opensbi {
            description = "OpenSBI";
            data = /incbin/("fw_jump.bin");
            type = "kernel";
            arch = "riscv";
            os = "linux";
            compression = "none";
            load = <0x08000000>;
            entry = <0x08000000>;
            hash { algo = "sha256"; };
        };

        linux {
            description = "Linux";
            data = /incbin/("Image");
            type = "kernel";
            arch = "riscv";
            os = "linux";
            compression = "none";
            load = <0x08200000>;
            hash { algo = "sha256"; };
        };

        fdt {
            description = "K230 device tree";
            data = /incbin/("k230-qemu.dtb");
            type = "flat_dt";
            arch = "riscv";
            compression = "none";
            load = <0x0a000000>;
            hash { algo = "sha256"; };
        };

        ramdisk {
            description = "BusyBox initramfs";
            data = /incbin/("rootfs.cpio.gz");
            type = "ramdisk";
            arch = "riscv";
            os = "linux";
            compression = "none";
            load = <0x10000000>;
            hash { algo = "sha256"; };
        };
    };

    configurations {
        default = "boot";
        boot {
            kernel = "opensbi";
            loadables = "linux";
            fdt = "fdt";
            ramdisk = "ramdisk";
        };
    };
};
```

## machine/riscv64/k230/buildroot-external/configs/k230_qemu_defconfig
```kconfig
BR2_riscv=y
BR2_RISCV_ISA_RVC=y
BR2_TOOLCHAIN_EXTERNAL=y
BR2_TOOLCHAIN_EXTERNAL_CUSTOM=y
BR2_TOOLCHAIN_EXTERNAL_PREINSTALLED=y
BR2_TOOLCHAIN_EXTERNAL_PATH="/opt/toolchain/Xuantie-900-gcc-linux-6.6.0-glibc-x86_64-V3.0.2"
BR2_TOOLCHAIN_EXTERNAL_CUSTOM_PREFIX="riscv64-unknown-linux-gnu"
BR2_TOOLCHAIN_EXTERNAL_GCC_14=y
BR2_TOOLCHAIN_EXTERNAL_HEADERS_6_6=y
BR2_TOOLCHAIN_EXTERNAL_CUSTOM_GLIBC=y
BR2_TOOLCHAIN_EXTERNAL_CXX=y
BR2_TOOLCHAIN_EXTERNAL_FORTRAN=y
BR2_TOOLCHAIN_EXTERNAL_OPENMP=y
# BR2_TOOLCHAIN_EXTERNAL_INET_RPC is not set
BR2_REPRODUCIBLE=y
BR2_GLOBAL_PATCH_DIR="$(BR2_EXTERNAL_K230_QEMU_PATH)/patches"
BR2_TARGET_GENERIC_HOSTNAME="k230"
BR2_TARGET_GENERIC_GETTY_PORT="ttyS0"
BR2_TARGET_GENERIC_GETTY_BAUDRATE_115200=y
BR2_SYSTEM_DHCP=""
# BR2_PACKAGE_IFUPDOWN_SCRIPTS is not set
BR2_ROOTFS_POST_IMAGE_SCRIPT="$(BR2_EXTERNAL_K230_QEMU_PATH)/board/post-image.sh"
BR2_LINUX_KERNEL=y
BR2_LINUX_KERNEL_CUSTOM_TARBALL=y
BR2_LINUX_KERNEL_CUSTOM_TARBALL_LOCATION="https://github.com/ruyisdk/linux-xuantie-kernel/archive/7d4e1f444f461dbe3833bd99a4640e7b6c2cd529.tar.gz"
BR2_LINUX_KERNEL_USE_CUSTOM_CONFIG=y
BR2_LINUX_KERNEL_CUSTOM_CONFIG_FILE="$(BR2_EXTERNAL_K230_QEMU_PATH)/board/linux.config"
BR2_LINUX_KERNEL_IMAGE=y
BR2_LINUX_KERNEL_DTS_SUPPORT=y
BR2_LINUX_KERNEL_CUSTOM_DTS_PATH="$(BR2_EXTERNAL_K230_QEMU_PATH)/board/k230-qemu.dts"
BR2_LINUX_KERNEL_NEEDS_HOST_OPENSSL=y
BR2_TARGET_ROOTFS_CPIO=y
BR2_TARGET_ROOTFS_CPIO_GZIP=y
# BR2_TARGET_ROOTFS_TAR is not set
BR2_TARGET_OPENSBI=y
BR2_TARGET_OPENSBI_CUSTOM_VERSION=y
BR2_TARGET_OPENSBI_CUSTOM_VERSION_VALUE="1.4"
BR2_TARGET_OPENSBI_PLAT="generic"
# BR2_TARGET_OPENSBI_INSTALL_DYNAMIC_IMG is not set
BR2_TARGET_OPENSBI_INSTALL_JUMP_IMG=y
BR2_TARGET_OPENSBI_ADDITIONAL_VARIABLES="FW_TEXT_START=0x08000000 FW_JUMP_ADDR=0x08200000 FW_JUMP_FDT_ADDR=0x0a000000 FW_PAYLOAD=n"
BR2_TARGET_UBOOT=y
BR2_TARGET_UBOOT_BUILD_SYSTEM_KCONFIG=y
BR2_TARGET_UBOOT_CUSTOM_VERSION=y
BR2_TARGET_UBOOT_CUSTOM_VERSION_VALUE="2022.10"
BR2_TARGET_UBOOT_BOARD_DEFCONFIG="k230_canmv"
BR2_TARGET_UBOOT_CONFIG_FRAGMENT_FILES="$(BR2_EXTERNAL_K230_QEMU_PATH)/board/uboot.fragment"
BR2_TARGET_UBOOT_FORMAT_ELF=y
BR2_TARGET_UBOOT_NEEDS_DTC=y
BR2_TARGET_UBOOT_NEEDS_OPENSSL=y
BR2_TARGET_UBOOT_NEEDS_PYTHON3=y
BR2_TARGET_UBOOT_NEEDS_XXD=y
BR2_PACKAGE_HOST_UBOOT_TOOLS=y
BR2_PACKAGE_HOST_UBOOT_TOOLS_FIT_SUPPORT=y
```

## machine/riscv64/k3-pico-itx/recipe/configs/k3-qemu-initramfs_defconfig
```kconfig
BR2_riscv=y
BR2_riscv_custom=y
BR2_RISCV_ISA_RVM=y
BR2_RISCV_ISA_RVA=y
BR2_RISCV_ISA_RVF=y
BR2_RISCV_ISA_RVD=y
BR2_RISCV_ISA_RVC=y
BR2_TOOLCHAIN_EXTERNAL=y
BR2_TOOLCHAIN_EXTERNAL_CUSTOM=y
BR2_TOOLCHAIN_EXTERNAL_PREINSTALLED=y
BR2_TOOLCHAIN_EXTERNAL_PATH="/opt/spacemit-toolchain"
BR2_TOOLCHAIN_EXTERNAL_CUSTOM_PREFIX="$(ARCH)-unknown-linux-gnu"
BR2_TOOLCHAIN_EXTERNAL_GCC_15=y
BR2_TOOLCHAIN_EXTERNAL_HEADERS_6_12=y
BR2_TOOLCHAIN_EXTERNAL_CUSTOM_GLIBC=y
BR2_TOOLCHAIN_EXTERNAL_CXX=y
BR2_TOOLCHAIN_EXTERNAL_FORTRAN=y
BR2_TOOLCHAIN_EXTERNAL_OPENMP=y
# BR2_TOOLCHAIN_EXTERNAL_INET_RPC is not set
BR2_REPRODUCIBLE=y
BR2_TARGET_GENERIC_HOSTNAME="k3-qemu"
BR2_TARGET_GENERIC_ISSUE="K3 QEMU functional test image"
BR2_INIT_BUSYBOX=y
BR2_TARGET_GENERIC_GETTY_PORT="ttyS0"
BR2_TARGET_GENERIC_GETTY_BAUDRATE_115200=y
BR2_ROOTFS_OVERLAY="/recipe/rootfs-overlay"
BR2_TARGET_ROOTFS_CPIO=y
BR2_TARGET_ROOTFS_CPIO_GZIP=y
# BR2_TARGET_ROOTFS_TAR is not set
```

## machine/riscv64/k3-pico-itx/recipe/configs/opensbi-qemu_defconfig
```kconfig
CONFIG_FDT_HSM=y
CONFIG_FDT_IPI=y
CONFIG_FDT_IPI_MSWI=y
CONFIG_FDT_IRQCHIP=y
CONFIG_FDT_IRQCHIP_APLIC=y
CONFIG_FDT_IRQCHIP_IMSIC=y
CONFIG_FDT_SERIAL=y
CONFIG_FDT_SERIAL_UART8250=y
CONFIG_FDT_TIMER=y
CONFIG_FDT_TIMER_MTIMER=y
```
